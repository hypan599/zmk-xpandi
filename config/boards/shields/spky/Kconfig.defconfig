## config/boards/shields/spky/Kconfig.defconfig
```kconfig
if SHIELD_SPKY_LEFT

config ZMK_KEYBOARD_NAME
    default "SPKYv1"

config ZMK_SPLIT_ROLE_CENTRAL
    default y

endif

if SHIELD_SPKY_LEFT || SHIELD_SPKY_RIGHT

config ZMK_SPLIT
    default y

endif
```

## config/boards/shields/spky/Kconfig.shield
```kconfig
config SHIELD_SPKY_LEFT
    def_bool $(shields_list_contains,spky_left)

config SHIELD_SPKY_RIGHT
    def_bool $(shields_list_contains,spky_right)
```

## config/boards/shields/spkyv2/Kconfig.defconfig
```kconfig
# Copyright (c) 2020 Ryan Cross
# SPDX-License-Identifier: MIT


config ZMK_USB
	default y

if SHIELD_SKPYV2

config ZMK_KEYBOARD_NAME
    default "SPKYv2"

endif
```

## config/boards/shields/spkyv2/Kconfig.shield
```kconfig
# Copyright (c) 2020 Ryan Cross
# SPDX-License-Identifier: MIT

config SHIELD_SPKYV2
    def_bool $(shields_list_contains,spkyv2)
```

## config/boards/shields/xsp/Kconfig.shield
```kconfig
# Copyright (c) 2020 Ryan Cross
# SPDX-License-Identifier: MIT

config SHIELD_XSP_LEFT
    def_bool $(shields_list_contains,xsp_left)

config SHIELD_XSP_RIGHT
    def_bool $(shields_list_contains,xsp_right)
```

## config/west.yml
```yaml
manifest:
  remotes:
    - name: zmkfirmware
      url-base: https://github.com/zmkfirmware
    - name: urob
      url-base: https://github.com/urob
    - name: benvallack
      url-base: https://github.com/benvallack
    - name: ftc
      url-base: https://github.com/ftc/
    - name: hypan599
      url-base: https://github.com/hypan599
  projects:
    - name: zmk
      remote: zmkfirmware
      revision: v0.3
      import: app/west.yml
    # - name: zmk
    #   remote: urob
    #   revision: main
    #   import: app/west.yml
    - name: zmk-helpers
      remote: urob
      revision: main
  self:
    path: config
```
